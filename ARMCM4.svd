# ASR6601 register map
Vendor: ASR Microelectronics; Series: ASR6601; File version: 1.1
ASR6601 LPWAN SoC family with Arm China STAR-MC1 processor. ASR6601SE has 256 KiB Flash and 64 KiB SRAM; ASR6601CB has 128 KiB Flash and 16 KiB SRAM.
CPU: CM4 r0p1, little endian, no MPU, FPU, VTOR, 3 interrupt priority bits
Registers are 32-bit, read-write, no defined reset value unless marked. A register's access mark holds for its fields unless they carry their own. Offsets are from the block's base; lines under a group give offsets from that group; [hi:lo] are bit positions; {n}, {i} and the like mark numbered series; 'fields as' and 'values as' point back to an identical list; <NAME> marks a mode.

## Memory map
0x40000000 RCC size 0x34 — Reset and clock control
0x40001000 SYSCFG size 0x2C — System configuration controller
0x40001800 PWR size 0x20 — Power controller
0x40002000 I2S size 0x200 — Inter-IC sound interface
0x40003000 UART0 size 0x1000
0x40004000 UART1 size 0x1000 — UART1 instance
0x40005000 LPUART size 0x14 — Low-power UART
0x40006000 SSP0 size 0x1000
0x40007000 I2C0 size 0x48
0x40008200 AFEC size 0xC — Analog front-end controller digital registers
0x40009000 LORAC size 0x11C — LoRa controller interface
0x4000A000 TIMER0 size 0x54
0x4000B000 TIMER2 size 0x54 — TIMER2 instance
0x4000C000 BSTIMER0 size 0x30
0x4000D000 LPTIMER0 size 0x28
0x4000D800 LPTIMER1 size 0x28 — LPTIMER1 instance
0x4000E000 RTC size 0x4C — Real-time clock
0x4000F000 SEC size 0x1C — Security controller
0x40010000 UART2 size 0x1000 — UART2 instance
0x40011000 UART3 size 0x1000 — UART3 instance
0x40012000 SSP1 size 0x1000 — SSP1 instance
0x40013000 SSP2 size 0x1000 — SSP2 instance
0x40014000 I2C1 size 0x48 — I2C1 instance
0x40015000 I2C2 size 0x48 — I2C2 instance
0x40017000 ADC size 0x2C — 12-bit analog-to-digital converter
0x40018000 LCD size 0x30 — Segment LCD controller
0x40019000 DAC size 0x14 — 12-bit digital-to-analog converter
0x4001A000 TIMER1 size 0x54 — TIMER1 instance
0x4001B000 TIMER3 size 0x54 — TIMER3 instance
0x4001C000 BSTIMER1 size 0x30 — BSTIMER1 instance
0x4001D000 IWDG size 0x1C — Independent watchdog
0x4001E000 WDG size 0x1000 — Watchdog timer
0x4001F000 GPIOA size 0x44
0x4001F400 GPIOB size 0x44 — GPIOB instance
0x4001F800 GPIOC size 0x44 — GPIOC instance
0x4001FC00 GPIOD size 0x44 — GPIOD instance
0x40020000 EFC size 0x50 — Embedded flash controller
0x40021000 QSPI — Quad SPI controller
0x40022000 CRC size 0x10 — CRC calculation unit
0x40023000 DMA0 size 0x3F8 — DMA Controller 0
0x40024000 DMA1 size 0x3F8 — DMA1 instance
0x40030000 CRYPTO_ARAM_MIX size 0x1000 — Security algorithm working RAM window
0x40031000 CRYPTO_ARAM_ALONG size 0x1000 — Security algorithm working RAM window
0x40032000 SAE size 0x38 — Security algorithm engine
0x40033000 RNG size 0x28 — Hardware random-number generator

## Interrupts
0 SEC
1 RTC
2 WDG
3 EFC
4 UART3
5 I2C2
6 UART0
7 UART1
8 UART2
9 LPUART
10 SSP0
11 SSP1
12 QSPI
13 I2C0
14 I2C1
15 SCC (SEC) — SDK SCC interrupt vector; SDK does not publish an SCC MMIO base
16 ADC
17 AFEC
18 SSP2
19 DMA1
20 DAC
21 LORA (LORAC)
22 GPIO (GPIOA)
23 TIMER0
24 TIMER1
25 TIMER2
26 TIMER3
27 BSTIMER0
28 BSTIMER1
29 LPTIMER0
30 SAC (SAE) — SDK SAC interrupt vector; SDK does not state MMIO ownership
31 DMA0
32 I2S
33 LCD
34 PWR
35 LPTIMER1
36 IWDG

## SYSCFG — System configuration controller
Base 0x40001000
{0x0+4i} CR{i} (i=0..10) — control register {i}

## PWR — Power controller
Base 0x40001800
0x00 CR0 — control register 0
0x04 CR1 — control register 1
0x08 SR0 — status register 0
0x0C SR1 — status register 2
{0x8+4i} CR{i} (i=2..5) — control register {i+1}

## I2S — Inter-IC sound interface
Base 0x40002000
0x00 IER — enable register
0x04 IRER — receiver block enable register
0x08 ITER — transmitter block enable register
0x0C CER — clock enable register
0x10 CCR — clock configuration register
0x14 RXFFR wo — receiver block FIFO reset register
0x18 TXFFR wo — transmitter block FIFO reset register
0x20 LRBR_LTHR — right receive buffer register
0x24 RRBR_RTHR — right transmit holding register
0x28 RER — receiver enable register
0x2C TER — transmitter enable register
0x30 RCR — receiver configuration register
0x34 TCR — transmitter configuration register
0x38 ISR ro — interrupt status register
0x3C IMR — interrupt mask register
0x40 ROR ro — receiver overrun register
0x44 TOR ro — transmitter overrun register
0x48 RFCR — receiver FIFO configuration register
0x4C TFCR — transmitter FIFO configuration register
0x50 RFF wo — receiver FIFO flush register
0x54 TFF wo — transmitter FIFO flush register
0x1C0 RXDMA — receiver block dma register
0x1C4 RRXDMA wo — reset receiver block dma register
0x1C8 TXDMA — transmitter block dma register
0x1CC RTXDMA wo — reset transmitter block dma register
0x1F0 I2S_COMP_PARAM_2 ro — component parameter register 2
0x1F4 I2S_COMP_PARAM_1 ro — component parameter register 1
0x1F8 I2S_COMP_VERSION ro — component version register
0x1FC I2S_COMP_TYPE ro — component type register

## Licence text in the file
Reverse-engineered device description derived from the ASR6601 datasheet and the ASR6601 SDK register declarations. Verify undocumented behavior against target hardware.
